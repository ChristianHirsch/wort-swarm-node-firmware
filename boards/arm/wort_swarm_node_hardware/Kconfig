## boards/arm/wort_swarm_node_hardware/Kconfig
```kconfig
# Kconfig - wort_swarm_node_hardware

if BOARD_WORT_SWARM_NODE_HARDWARE

config BOARD_ENABLE_DCDC
        bool "Enable DCDC mode"
        select SOC_DCDC_NRF52X
        default y

endif # BOARD_WORT_SWARM_NODE_HARDWARE
```

## boards/arm/wort_swarm_node_hardware/Kconfig.board
```kconfig
# Kconfig - wort_swarm_node_hardware board configuration

config  BOARD_WORT_SWARM_NODE_HARDWARE
	bool "wort_swarm_node_hardware"
	depends on SOC_NRF52840_QIAA
```

## boards/arm/wort_swarm_node_hardware/Kconfig.defconfig
```kconfig
# Kconfig - wort_swarm_node_hardware board configuration

if BOARD_WORT_SWARM_NODE_HARDWARE

config BOARD
	default "wort_swarm_node_hardware"

if I2C

config I2C_0
	default y

endif # I2C

#if PWM

#config PWM_0
#	default y

#endif # PWM

#if SPI

#config SPI_1
#	default y

#config SPI_2
#	default y

#endif # SPI

if USB

config USB_NRFX
	default y

config USB_DEVICE_STACK
	default y

endif # USB

if IEEE802154

config IEEE802154_NRF5
	default y

endif # IEEE802154

config BT_CTLR
	default BT

endif # BOARD_WORT_SWARM_NODE_HARDWARE
```

## boards/arm/wort_swarm_node_hardware/wort_swarm_node_hardware_defconfig
```kconfig
# SPDX-License-Identifier: Apache-2.0

CONFIG_SOC_SERIES_NRF52X=y
CONFIG_SOC_NRF52840_QIAA=y
CONFIG_BOARD_WORT_SWARM_NODE_HARDWARE=y

# Enable MPU
CONFIG_ARM_MPU=y

# enable GPIO
CONFIG_GPIO=y

# additional board options
CONFIG_GPIO_AS_PINRESET=y
```

## drivers/sensor/si705x/Kconfig
```kconfig
# Kconfig.SI705X - SI705X SI-705X I2C-based temperature sensor
# SPDX-License-Identifier: Apache-2.0

menuconfig SI705X
	bool "SI705X sensor"
	depends on I2C
	help
	  Enable driver for SI705X I2C-based temperature sensor.

if SI705X

endif # SI705X
```
